## config/boards/shields/ar_vanana/Kconfig.defconfig
```kconfig
# Copyright (c) 2020 dELLIKEEb
# SPDX-License-Identifier: MIT

if SHIELD_AR_VANANA

config ZMK_KEYBOARD_NAME
	default "AR Vanana"

endif
```

## config/boards/shields/ar_vanana/Kconfig.shield
```kconfig
# Copyright (c) 2020 dELLIKEEb
# SPDX-License-Identifier: MIT

config SHIELD_AR_VANANA
	def_bool $(shields_list_contains,ar_vanana)
```

## config/boards/shields/vanana - AR/Kconfig.defconfig
```kconfig
# Copyright (c) 2020 dELLIKEEb
# SPDX-License-Identifier: MIT

if SHIELD_AR

config ZMK_KEYBOARD_NAME
	default "AR"

endif
```

## config/boards/shields/vanana - AR/Kconfig.shield
```kconfig
# Copyright (c) 2020 dELLIKEEb
# SPDX-License-Identifier: MIT

config SHIELD_AR
	def_bool $(shields_list_contains,ar)
```
